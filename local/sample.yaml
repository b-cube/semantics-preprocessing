## local/sample.yaml
```yaml
fields:
  - raw_content
  - id
  - date
sample:
  start: 0
  end: 20
  size: 2
query:
  raw_content:
    - http://www.isotc211.org/2005/gmi
    - http://www.isotc211.org/2005/gmd
ext: json
```
